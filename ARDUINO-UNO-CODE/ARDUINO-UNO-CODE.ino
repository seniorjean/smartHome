// generated by KidsBlock
#include <Arduino.h>
#include <lcd.h>

#include <DHT.h>
#include <Servo.h>
#include <Ultrasonic.h>

char wifiData = 'a';

int ip_flag = 1;

int ultra_state = 0;

int temp_state = 0;

int humidity_state = 0;

lcd Lcd;

DHT dht_(3, 11);
Servo servo_9;
Ultrasonic ultrasonic_11_10(11, 10);

void turnOnFan() {
  digitalWrite(A2, LOW);
  digitalWrite(A3, HIGH);
}


void turnOffFan() {
  digitalWrite(A2, LOW);
  digitalWrite(A3, LOW);
}


void turnOnAlarm() {
  digitalWrite(8, HIGH);
}


void turnOffAlarm() {
  digitalWrite(8, LOW);
}


void doorClose() {
  servo_9.write(0);
}


void doorOpen() {
  servo_9.write(90);
}


void relayOff() {
  digitalWrite(6, LOW);
}


void relayOn() {
  digitalWrite(6, HIGH);
}


void setup() {
  Lcd.Init();

  servo_9.attach(9);
  Serial.begin(115200);
  pinMode(2, OUTPUT);
  pinMode(3, OUTPUT);
  pinMode(6, OUTPUT);
  pinMode(8, OUTPUT);
  pinMode(9, OUTPUT);
  pinMode(13, OUTPUT);
  pinMode(12, OUTPUT);
  pinMode(11, OUTPUT);
  pinMode(A5, OUTPUT);
  digitalWrite(A2, LOW);
  digitalWrite(A3, LOW);
  digitalWrite(6, LOW);
  Lcd.Clear();
  Lcd.Cursor(0,0);
  Lcd.Display("Vision Hub");
  Lcd.Cursor(1,0);
  Lcd.Display("Technologies");
  Lcd.Cursor(2,0);
  Lcd.Display("Smart Home");
  servo_9.write(0);
}

void loop() {
  if (Serial.available() > 0) {
    wifiData=Serial.read();
    Serial.println(wifiData);
    if (wifiData == '*') {
      ip_flag=0;
    }
    if (ip_flag == 1) {
      Serial.print(wifiData);
      if (wifiData == '#') {
        Serial.println("");
      }
      delay(0.1 * 1000);
    }
  }
  if (wifiData == 'R') {
    relayOn();
  }
  if (wifiData == 'r') {
    relayOff();
  }
  if (wifiData == 'D') {
    doorOpen();
  }
  if (wifiData == 'd') {
    doorClose();
  }
  if (wifiData == 'F') {
    turnOnFan();
  }
  if (wifiData == 'f') {
    turnOffFan();
  }
  if (wifiData == 'U') {
    while (!(ultra_state > 0)) {
      Serial.print("***Distance = ");
      Serial.print(ultrasonic_11_10.read(CM));
      Serial.println("!!!#");
      ultra_state=1;
    }
  }
  if (wifiData == 'u') {
    ultra_state=0;
  }
  if (wifiData == 'T') {
    while (!(temp_state > 0)) {
      Serial.print("***Température = ");
      Serial.print(dht_.readTemperature(false));
      Serial.println("!!!#");
      temp_state=1;
    }
  }
  if (wifiData == 't') {
    temp_state=0;
  }
  if (wifiData == 'H') {
    while (!(humidity_state > 0)) {
      Serial.print("***Humidité = ");
      Serial.print(dht_.readHumidity());
      Serial.println("!!!#");
      humidity_state=1;
    }
  }
  if (wifiData == 'h') {
    humidity_state=0;
  }
  if (wifiData == 'L') {
    digitalWrite(13, HIGH);
  }
  if (wifiData == 'l') {
    digitalWrite(13, LOW);
  }
  if (wifiData == 'Z') {
    digitalWrite(12, HIGH);
  }
  if (wifiData == 'z') {
    digitalWrite(12, LOW);
  }
  if (wifiData == 'X') {
    digitalWrite(11, HIGH);
  }
  if (wifiData == 'x') {
    digitalWrite(11, LOW);
  }
}
